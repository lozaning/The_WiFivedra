## controller_espidf/sdkconfig.defaults
```kconfig
# ESP32 Controller Configuration

# Target
CONFIG_IDF_TARGET="esp32"

# Serial flasher config
CONFIG_ESPTOOLPY_FLASHSIZE_4MB=y

# Component config
CONFIG_ESP_TASK_WDT_TIMEOUT_S=10

# FreeRTOS
CONFIG_FREERTOS_HZ=1000

# UART
CONFIG_UART_ISR_IN_IRAM=y

# FAT filesystem
CONFIG_FATFS_LFN_HEAP=y
CONFIG_FATFS_MAX_LFN=255

# Log output
CONFIG_LOG_DEFAULT_LEVEL_INFO=y
CONFIG_LOG_MAXIMUM_LEVEL_VERBOSE=y
```

## firmware/sdkconfig.defaults
```kconfig
# Target
CONFIG_IDF_TARGET="esp32c5"
CONFIG_ESPTOOLPY_FLASHSIZE_4MB=y

# Console: disable completely — USB CDC carries binary SLIP data
CONFIG_ESP_CONSOLE_NONE=y
CONFIG_ESP_CONSOLE_SECONDARY_NONE=y
CONFIG_BOOTLOADER_LOG_LEVEL_NONE=y
CONFIG_LOG_DEFAULT_LEVEL_NONE=y

# FreeRTOS
CONFIG_FREERTOS_HZ=1000

# WiFi — skip NVS calibration storage
CONFIG_ESP_WIFI_NVS_ENABLED=n
```

## subordinate_espidf/sdkconfig.defaults
```kconfig
# ESP32-C5 Subordinate Configuration

# Target
CONFIG_IDF_TARGET="esp32c5"

# Serial flasher config
CONFIG_ESPTOOLPY_FLASHSIZE_4MB=y

# Component config
CONFIG_ESP_TASK_WDT_TIMEOUT_S=10

# FreeRTOS
CONFIG_FREERTOS_HZ=1000

# UART
CONFIG_UART_ISR_IN_IRAM=y

# WiFi
CONFIG_ESP_WIFI_STATIC_RX_BUFFER_NUM=10
CONFIG_ESP_WIFI_DYNAMIC_RX_BUFFER_NUM=32
CONFIG_ESP_WIFI_DYNAMIC_TX_BUFFER_NUM=32
CONFIG_ESP_WIFI_AMPDU_TX_ENABLED=y
CONFIG_ESP_WIFI_TX_BA_WIN=6
CONFIG_ESP_WIFI_AMPDU_RX_ENABLED=y
CONFIG_ESP_WIFI_RX_BA_WIN=6

# Log output
CONFIG_LOG_DEFAULT_LEVEL_INFO=y
CONFIG_LOG_MAXIMUM_LEVEL_VERBOSE=y
```
